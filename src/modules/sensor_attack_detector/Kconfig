## src/modules/sensor_attack_detector/Kconfig
```kconfig
menuconfig MODULES_SENSOR_ATTACK_DETECTOR
	bool "sensor_attack_detector"
	default n
	---help---
		Enable the sensor attack detector module
```
